#include "main.h"																													//
																																					//
static _Bool statePB0 = 0;																								//	Текущее состояние на выводе PB.0: 0 - светодиод погашен; 1 - светодиод горит
static uint32_t half_period = 2048;																				//	Полупериод мигания светодиода
																																					//
int main()																																//	Основная программа микроконтроллера
{																																					//
	__disable_irq();																												//	Глобальное запрещение прерываний
	InitPortB();																														//	Инициализация порта B
	InitTimer6();																														//	Инициализация таймера TIM6
	NVIC->ISER[0] |= 0x20000;																								//	Разрешение в NVIC прерывания от модуля TIM6 (17 линия)
	__enable_irq();																													//	Глобальное разрешение прерываний
	TIM6->CR1 |= 0x1;																												//	Разрешение работы таймера
	while (1);																															//	Пустой цикл основной программы
}																																					//
																																					//
void InitPortB(void)																											//	Функция инициализации порта B с подключенным светодиодом VD0 и микропереключателями SW3 и SW4
{																																					//
	RCC->AHBENR|=RCC_AHBENR_GPIOBEN;																				//	Включение тактирования порта B: RCC_AHBENR_GPIOBEN=0x00040000
	GPIOB->MODER|=GPIO_MODER_MODER0_0 | GPIO_MODER_MODER8_0;								//	Переключение линий 0 и 8 в режим "Output": GPIO_MODER_MODER0_0 = 0x1; GPIO_MODER_MODER8_0 = 0x10000
	GPIOB->MODER&=~(GPIO_MODER_MODER12 																			//
								| GPIO_MODER_MODER13 																			//
							  | GPIO_MODER_MODER14);																		//	Переключение линий 12 (SW4), 13 (SW3) и 14 (SW2) порта B в режим "Input"
	GPIOB->BSRR=0x100;																											//	Разрешение работы светодиодов на стенде STM_01 с помощью установки логической "1" на выводе PB.8
}																																					//
																																					//
void InitTimer6(void)																											//	Функция инициализация базового таймера TIM6
{																																					//	
	RCC->APB1ENR=RCC_APB1ENR_TIM6EN;																				//	Включение тактирования модуля таймер TIM6
	TIM6->PSC=100;																													  //	Установка коэффициента предделителя равного 8000: после предделителя частота сигнала = Частота на шине AP8 / 8000 = 8 МГц / 8000 = 1 кГц
	TIM6->ARR=half_period;																									//	Длительность периода обновления таймера = half_period / 1 кГц = 125 / 1000 = 0.125 секунды при инициализации таймера
	TIM6->DIER|=0x1;																												//	Разрешить аппаратную уставноку сигнала прерывания при событии обновления таймера (UEV)
}																																					//
																																					//
void TIM6_DAC_IRQHandler(void)																						//	Функция-обработчик прерывания таймера TIM6
{																																					//  Установка длительности периода обновления таймера в соответсвии с SW2, SW3 и SW4
	if (statePB0==0)                                                        //  Если светодиод выключен,
		TIM6->ARR = 2040 - 290 * (((GPIOB->IDR)&0x7000)>>12);	                //  
	else if (statePB0 == 1)                                                 //  Если светодиод включен
    TIM6->ARR = 8 + 290 * (((GPIOB->IDR)&0x7000)>>12);	                  //
				                                                                  //	
	statePB0 = !statePB0;																										//	Инвертировать состояние светодиода VD0
	GPIOB->BRR = 0x1;																												//	Отключить светодиод на выводе PB.0 
	GPIOB->BSRR = statePB0;																									//	Уставновить светодиод на выводе PB.0 в соответствии с состоянием, хранимым в переменноой statePB0
	TIM6->SR=0;																															//	Сбросить флаг прерывания таймера TIM6
}	
