#include "main.h"																													//
static double tim7Time[4] = {8,6,4,2};		
static _Bool statePB0 = 0;	
static double t_n[390]={} ;
static uint32_t phase = 0;
static uint32_t SW_1_2 ;
static uint32_t T;

																																					//
int main()																																//	Основная программа микроконтроллера
{																																					//
	__disable_irq();																												//	Глобальное запрещение прерываний
	InitPortB();
	
	InitMass();
	InitTimer();																														//	Инициализация таймера TIM6
	NVIC->ISER[0] |= 0x60000;																								//	Разрешение в NVIC прерывания от модуля TIM6 (17 линия)
	__enable_irq();																													//	Глобальное разрешение прерываний
	TIM7->CR1 |= 0x1;																												//	Разрешение работы таймера
	TIM6->CR1 |= 0x1;
	while (1);																															//	Пустой цикл основной программы
}																																					//
																																					//
void InitPortB(void)																											//	Функция инициализации порта B с подключенным светодиодом VD0 и микропереключателями SW3 и SW4
{																																					//
	RCC->AHBENR|=RCC_AHBENR_GPIOBEN;																				//	Включение тактирования порта B: RCC_AHBENR_GPIOBEN=0x00040000
	GPIOB->MODER|=GPIO_MODER_MODER0_0 | GPIO_MODER_MODER8_0 
																		| GPIO_MODER_MODER1_0;								//	Переключение линий 0 и 8 в режим "Output": GPIO_MODER_MODER0_0 = 0x1; GPIO_MODER_MODER8_0 = 0x10000
	GPIOB->MODER&=~(GPIO_MODER_MODER12 																			//
								| GPIO_MODER_MODER13 																			//
							  | GPIO_MODER_MODER14
								| GPIO_MODER_MODER15);																		//	Переключение линий 12 (SW4), 13 (SW3) и 14 (SW2) порта B в режим "Input"
	GPIOB->BSRR=0x100;																											//	Разрешение работы светодиодов на стенде STM_01 с помощью установки логической "1" на выводе PB.8
}																																					//
																																					//
void InitMass(void)
{
	T= 4000 + 1000 * (((GPIOB->IDR)&0xc000)>>14);
	SW_1_2=(((GPIOB->IDR)&0xc000)>>12);
	for(int i = 0; i < 390; i++)
	{
		t_n[i]=((((0.95)*T/T-(0.01)*T/T)/389)*i)+(0.01)*T;
		if(i==0)
			t_n[i]=(0.01)*T;
	}
}

void InitTimer(void)																											//	Функция инициализация базового таймера TIM6
{																																					//	
	RCC->APB1ENR|=RCC_APB1ENR_TIM6EN|RCC_APB1ENR_TIM7EN;
	TIM6->PSC=4000 + 1000 * (((GPIOB->IDR)&0xc000)>>12);																													  //	Установка коэффициента предделителя равного 8000: после предделителя частота сигнала = Частота на шине AP8 / 8000 = 8 МГц / 8000 = 1 кГц
	TIM7->PSC=7999999;																													  //	Установка коэффициента предделителя равного 8000: после предделителя частота сигнала = Частота на шине AP8 / 8000 = 8 МГц / 8000 = 1 кГц
	TIM7->ARR=(uint32_t)tim7Time[(((GPIOB->IDR)&0x3000)>>12)];																									//	Длительность периода обновления таймера = half_period / 1 кГц = 125 / 1000 = 0.125 секунды при инициализации таймера
	TIM6->ARR=(uint32_t)(3000+2000*(((GPIOB->IDR)&0xc000)>>14));																									//	Длительность периода обновления таймера = half_period / 1 кГц = 125 / 1000 = 0.125 секунды при инициализации таймера
	TIM6->DIER|=0x1;																												//	Разрешить аппаратную уставноку сигнала прерывания при событии обновления таймера (UEV)
	TIM7->DIER|=0x1;																												//	Разрешить аппаратную уставноку сигнала прерывания при событии обновления таймера (UEV)
}																																					//

void TIM7_IRQHandler(void)																								//	Функция-обработчик прерывания таймера TIM7
{																																					//  Установка длительности периода обновления таймера в соответсвии с SW2, SW3 и SW4                                                      //  Если светодиод выключен,
	TIM7->ARR = tim7Time[(((GPIOB->IDR)&0x3000)>>12)];	              																//  Если светодиод включен
	phase++;
	if(phase==390)
		phase=0;																											//	Разрешение работы таймер																																		                                              //	
	TIM7->SR=0;																															//	Сбросить флаг прерывания таймера TIM6
}	

void TIM6_DAC_IRQHandler(void)																						//	Функция-обработчик прерывания таймера TIM6
{	
	if(SW_1_2!=(((GPIOB->IDR)&0xc000)>>14))
		T = (uint32_t)(4000 + 1000 * (((GPIOB->IDR)&0xc000)>>14));
		TIM6->PSC=T;
		InitMass();
	if (statePB0==0)                                                        //  Если светодиод выключен,
		TIM6->ARR =t_n[phase];  
	else                                                  //  Если светодиод включен
    TIM6->ARR = T;                                                //  Если светодиод включен	                //  
	
	statePB0 = !statePB0;																										//	Инвертировать состояние светодиода VD0																												//	Отключить светодиод на выводе PB.0 
	GPIOB->BSRR = statePB0;																									//	Уставновить светодиод на выводе PB.0 в соответствии с состоянием, хранимым в переменноой statePB0
	TIM6->SR=0;																															//	Сбросить флаг прерывания таймера TIM6
}		
